## buildroot-2014.05/configs/iPlayer4_BB_defconfig
```kconfig
BR2_arm=y
BR2_cortex_a8=y
BR2_ARM_EABIHF=y
BR2_ARM_FPU_VFPV3=y
BR2_DL_DIR="$(TOPDIR)/../dl"
BR2_TOOLCHAIN_EXTERNAL=y
BR2_TOOLCHAIN_EXTERNAL_GDB_SERVER_COPY=y
BR2_ECLIPSE_REGISTER=y
BR2_TARGET_GENERIC_HOSTNAME="iPlayer4"
BR2_TARGET_GENERIC_ISSUE="Welcome to iPlayer4"
BR2_TARGET_GENERIC_ROOT_PASSWD="root"
BR2_TARGET_GENERIC_GETTY_PORT="ttyO0"
BR2_TARGET_TZ_INFO=y
BR2_ROOTFS_OVERLAY="board/PCK/iPlayer4/rootfs-additions/"
BR2_ROOTFS_POST_BUILD_SCRIPT="board/PCK/iPlayer4/post-build.sh"
BR2_LINUX_KERNEL=y
BR2_LINUX_KERNEL_CUSTOM_GIT=y
BR2_LINUX_KERNEL_CUSTOM_REPO_URL="git://github.com/varigit/VAR-SOM-AM33-SDK7-Kernel.git"
BR2_LINUX_KERNEL_CUSTOM_REPO_VERSION="c74fbb9843534e3138d209d87927b0740dd516eb"
BR2_LINUX_KERNEL_PATCH="board/PCK/iPlayer4/linux-patches/linux-0001-debugUART.patch board/PCK/iPlayer4/linux-patches/linux-0002-am335x-pm-firmware.patch"
BR2_LINUX_KERNEL_DEFCONFIG="tisdk_var-som-am33"
BR2_PACKAGE_PHP=y
BR2_PACKAGE_FAKE_HW_CLOCK=y
BR2_PACKAGE_LIGHTTPD=y
BR2_PACKAGE_LIGHTTPD_OPENSSL=y
BR2_PACKAGE_LIGHTTPD_PCRE=y
BR2_PACKAGE_OPENSSH=y
BR2_TARGET_UBOOT=y
BR2_TARGET_UBOOT_BOARDNAME="am335x_evm"
BR2_TARGET_UBOOT_CUSTOM_GIT=y
BR2_TARGET_UBOOT_CUSTOM_REPO_URL="git://git.ti.com/ti-u-boot/ti-u-boot.git"
BR2_TARGET_UBOOT_CUSTOM_REPO_VERSION="259ff9a577cc66cb40e3cdff3e41628e466f0fef"
BR2_TARGET_UBOOT_FORMAT_IMG=y
```

## buildroot-2014.05/configs/iPlayer4_defconfig
```kconfig
BR2_arm=y
BR2_cortex_a8=y
BR2_ARM_EABIHF=y
BR2_ARM_FPU_VFPV3=y
BR2_DL_DIR="$(TOPDIR)/../dl"
BR2_TOOLCHAIN_EXTERNAL=y
BR2_TOOLCHAIN_EXTERNAL_GDB_SERVER_COPY=y
BR2_ECLIPSE_REGISTER=y
BR2_TARGET_TZ_INFO=y
BR2_LINUX_KERNEL=y
BR2_LINUX_KERNEL_CUSTOM_GIT=y
BR2_LINUX_KERNEL_CUSTOM_REPO_URL="git://github.com/varigit/VAR-SOM-AM33-SDK7-Kernel.git"
BR2_LINUX_KERNEL_CUSTOM_REPO_VERSION="c74fbb9843534e3138d209d87927b0740dd516eb"
BR2_LINUX_KERNEL_PATCH="(board/PCK/iPlayer4/linux-patches/linux-0001-debugUART.patch board/PCK/iPlayer4/linux-patches/linux-0002-am335x-pm-firmware.patch"
BR2_LINUX_KERNEL_DEFCONFIG="tisdk_var-som-am33"
BR2_TARGET_UBOOT=y
BR2_TARGET_UBOOT_BOARDNAME="var-som-am33"
BR2_TARGET_UBOOT_CUSTOM_GIT=y
BR2_TARGET_UBOOT_CUSTOM_REPO_URL="git://github.com/varigit/u-boot-VAR-SOM-AM33-SDK7.git"
BR2_TARGET_UBOOT_CUSTOM_REPO_VERSION="b458d2e9cf34a5a87cf6bef5ab12aeb58e607fde"
BR2_TARGET_UBOOT_FORMAT_IMG=y
BR2_TARGET_UBOOT_SPL=y
```

## buildroot-2014.05/package/fake_hw_clock/Config.in
```kconfig
config BR2_PACKAGE_FAKE_HW_CLOCK
	bool "fake_hw_clock"
	help
	  Custom made script for boards that do not have RTC. Script saves time
	  into a file on system shutdown and loads it back on system startup.
```

## buildroot-2014.05/package/nginx/Config.in
```kconfig
config BR2_PACKAGE_NGINX
        bool "nginx"
        select BR2_PACKAGE_OPENSSL
	select BR2_PACKAGE_PCRE
	select BR2_PACKAGE_ZLIB
	select BR2_PACKAGE_LOGROTATE
	select BR2_PACKAGE_LIBATOMIC_OPS
	default "n"
        help
	  nginx [engine x] is an HTTP and reverse proxy server, as well as a mail proxy server, written by Igor Sysoev.
	  
	  http://nginx.org

if BR2_PACKAGE_NGINX
config BR2_PACKAGE_NGINX_LOGS_DIR
        string "nginx logs directory"
        default /var/log/nginx
        help
          Sets directory where nginx will store its logs. Please note that this parameter
	  is not automatically updated in nginx config and start-up file (nginx.conf,S50nginx)
endif
```
